/*
 * The single external that kk_oled_font.c needs in order to be compiled for the
 * host: OLED_InternalPlotSource. Everything else in that file is self-contained,
 * which is what makes it possible to point the vendor's real decoder at the
 * font data generated by tools/gen_oled_fonts.py and prove the packing is right
 * without a display, a bus or a board.
 *
 * Pixels are collected into a canvas the test can inspect. The semantics match
 * the graphics core: a lit pixel wherever the font bit is 1, clipped to the
 * canvas, with SET mode only (no XOR/invert paths are exercised here).
 */
#include <stdbool.h>
#include <stdint.h>

#include "kk_oled_font_stubs.h"

#define STUB_W 128
#define STUB_H 32

static uint8_t s_canvas[STUB_H][STUB_W];
static uint32_t s_lit;
static int16_t s_off_x;
static int16_t s_off_y;

void stub_clear(void)
{
    for (uint32_t y = 0U; y < STUB_H; y++) {
        for (uint32_t x = 0U; x < STUB_W; x++) {
            s_canvas[y][x] = 0U;
        }
    }
    s_lit = 0U;
    s_off_x = 0;
    s_off_y = 0;
}

void stub_set_origin(int16_t x, int16_t y)
{
    s_off_x = x;
    s_off_y = y;
}

uint32_t stub_lit_count(void)
{
    return s_lit;
}

bool stub_pixel(uint32_t x, uint32_t y)
{
    if (x >= STUB_W || y >= STUB_H) {
        return false;
    }
    return s_canvas[y][x] != 0U;
}

void OLED_InternalPlotSource(int16_t x, int16_t y, bool source_pixel)
{
    int32_t cx;
    int32_t cy;

    if (!source_pixel) {
        return;                        /* background run: nothing to record */
    }
    cx = (int32_t)x + s_off_x;
    cy = (int32_t)y + s_off_y;
    if (cx < 0 || cy < 0 || cx >= STUB_W || cy >= STUB_H) {
        return;
    }
    if (s_canvas[(uint32_t)cy][(uint32_t)cx] == 0U) {
        s_canvas[(uint32_t)cy][(uint32_t)cx] = 1U;
        s_lit++;
    }
}
